## halow_P4_V1.3/components/shims/Kconfig
```kconfig
# Copyright 2024-2026 Morse Micro
# SPDX-License-Identifier: Apache-2.0
menu "Morse Micro Shim Configuration"
    config MM_RESET_N
        int "RESET_N pin for MM chip"
        default -1
        help
            Output gpio pin used to control the RESET_N line.

    config MM_RESET_SETTLE_MS
        int "Delay after releasing RESET_N, in milliseconds"
        default 20
        range 1 1000
        help
            Delay between releasing RESET_N and the first SPI clocking. This must cover the
            transceiver's boot, not just its reset pulse.

            The startup handshake clocks a training sequence and then polls for the command
            response. A transceiver that is still booting when that clocking starts can latch
            onto a bit phase that is not byte aligned with the host's framing and hold it for
            the rest of the boot, so the handshake reads a correct response at the wrong
            alignment and the driver rejects it as an invalid ack. The failure is intermittent
            and looks like absent or faulty hardware.

            Adjust this based on the boot time measured on your particular board to ensure
            that the transceiver has sufficient time to boot.

    config MM_WAKE
        int "WAKE pin for MM chip"
        default -1
        help
            Output gpio pin used to control the WAKE line.

    config MM_BUSY
        int "BUSY pin for the MM chip"
        default -1
        help
            Input pin used as a rising edge interrupt.

    config MM_SPI_SCK
        int "SCK pin for MM chip"
        default -1
        help
            SPI clock pin.

    config MM_SPI_MOSI
        int "MOSI pin for MM chip"
        default -1
        help
            SPI master out slave in pin.

    config MM_SPI_MISO
        int "MISO pin for MM chip"
        default -1
        help
            SPI master in slave out pin.

    config MM_SPI_MISO_PULLUP
        bool "Enable weak internal pull-up on HaLow MISO"
        default n
        help
            Bias MISO high when the peripheral releases the line. This does
            not drive MISO as an output or replace board-level pull resistors.
            On the P4 diagnostic profile it compares against v6 captures
            that echoed MOSI even while CS was high. It is an experiment,
            not a confirmed fix for transport initialization failures.

    config MM_SPI_CS
        int "SPI CS pin for MM chip"
        default -1
        help
            SPI chip select pin.

    config MM_SPI_CLOCK_MHZ
        int "SPI clock frequency for MM chip (MHz)"
        default 40
        range 1 40
        help
            Requested SPI clock frequency. The SPI peripheral may round this
            to a supported frequency; the actual frequency is logged at boot.
            Lower this when diagnosing command timeouts on jumper wiring.

    config MM_SPI_IRQ
        int "SPI IRQ pin for MM chip"
        default -1
        help
            Out of band interupt pin used to indicate that
            the MM chip has data for the host.

    config MM_SPI_STARTUP_PROBE
        bool "Compare SPI startup timing on ESP32-P4/MM6108"
        depends on IDF_TARGET_ESP32P4 && MM_CHIP_MM6108 && MM_TRANSPORT_DIAGNOSTICS
        default n
        help
            Run a bounded startup comparison: configured settings first, then
            a 200 ms reset settling interval, then 1 MHz SPI with that interval.
            Each retry resets the module. Stop at the first valid CMD63 ack
            and keep those settings for subsequent transfers. This diagnoses
            boot timing and signal integrity; it is not proof of a working scan.

    config MM_SPI_GPIO_PROBE
        bool "Compare with GPIO SPI after hardware startup fails"
        depends on MM_SPI_STARTUP_PROBE
        default n
        help
            After all three hardware-SPI probes fail, use the same pins for
            a bounded slow mode-0 GPIO test. Reuse SDK command and CRC checks
            to validate the MM6108 chip ID. This is diagnostic only: it leaves
            the module in reset and does not run a scan using GPIO SPI.
            If GPIO startup also fails, capture identical command sequences
            with normal controls, RESET held low, and CS held high. Readback
            is at the host pads only and cannot verify module-side wiring.
            Also compare MISO with no clocks and floating/up/down input bias.

    config MM_SPI_RX_ALIGNMENT_TRIAL
        bool "Validate one-bit RX alignment after ordinary startup fails"
        depends on MM_SPI_GPIO_PROBE
        default n
        help
            Experimental fallback for repeatable 0xfe command responses. The
            vendor Linux driver flags this as a possible one-bit RX offset,
            but its workaround is controller-specific and does not prove
            ESP32-P4 has the same fault. First run the ordinary SPI probes.
            Then try a streaming one-bit RX correction at 1 MHz, preserving
            carry across transfers while CS is low. Require unchanged SDK
            ACK checks and two matching, CRC-checked chip IDs after each of
            two resets before continuing normal firmware loading/scanning.
            If validation fails, disable correction and run GPIO diagnostics.

    config MM_TRANSPORT_DIAGNOSTICS
        bool "Enable detailed SPI/SDIO transport diagnostics"
        default n
        help
            Enable debug logs only for the transport layer, including the
            startup command acknowledgement and chip identification checks.
            Use this to locate Transport init failed before changing wiring
            or firmware settings. Logging may affect transaction timing.

endmenu
```

## halow_P4_V1.3/examples/softap/sdkconfig.defaults.esp32p4
```kconfig
# Elecrow ESP32-P4 with the directly stacked FGH100MABMD (MM6108) module.
CONFIG_ESP32P4_SELECTS_REV_LESS_V3=y
CONFIG_ESP32P4_REV_MIN_100=y
CONFIG_ESPTOOLPY_FLASHSIZE_16MB=y

CONFIG_HALOW_COUNTRY_CODE="US"
CONFIG_S1G_CHANNEL=44
CONFIG_S1G_OPCLASS=2
CONFIG_MM_RESET_N=9
CONFIG_MM_WAKE=-1
CONFIG_MM_BUSY=-1
CONFIG_MM_SPI_SCK=8
CONFIG_MM_SPI_MOSI=6
CONFIG_MM_SPI_MISO=7
CONFIG_MM_SPI_MISO_PULLUP=y
CONFIG_MM_SPI_CS=27
CONFIG_MM_SPI_IRQ=28
CONFIG_MM_SPI_CLOCK_MHZ=10
CONFIG_MM_TRANSPORT_DIAGNOSTICS=y
CONFIG_MM_SPI_STARTUP_PROBE=y
CONFIG_MM_SPI_GPIO_PROBE=y
CONFIG_MM_SPI_RX_ALIGNMENT_TRIAL=y
CONFIG_ESP_SYSTEM_USE_FRAME_POINTER=y
CONFIG_BOOTLOADER_LOG_LEVEL_WARN=y
CONFIG_MM_CHIP_MM6108=y
CONFIG_MM_BCF_FILE="bcf_fgh100mabmd.bin"
# CONFIG_HALOW_PS_MODE is not set
CONFIG_MBEDTLS_CMAC_C=y
```

## halow_P4_V1.3/examples/web_camera_serve/main/Kconfig.projbuild
```kconfig
menu "Elecrow P4 HaLow camera"
    config P4_CAMERA_SDA
        int "SC2336 SCCB SDA GPIO"
        default 12
    config P4_CAMERA_SCL
        int "SC2336 SCCB SCL GPIO"
        default 13
    config P4_CAMERA_MAX_WIDTH
        int "JPEG maximum width (height aligned to 16 pixels)"
        range 160 1280
        default 320
    config P4_CAMERA_JPEG_QUALITY
        int "JPEG quality"
        range 10 95
        default 45
    config P4_CAMERA_FPS
        int "Maximum MJPEG frames per second"
        range 1 15
        default 5
    config P4_CAMERA_SD
        bool "Enable SD card photo saving (J5, 1-bit SDMMC)"
        default y
endmenu
```

## halow_P4_V3.2/examples/web_camera_serve/sdkconfig.defaults
```kconfig
CONFIG_SPIRAM=y
CONFIG_SPIRAM_SPEED_200M=y
CONFIG_SPIRAM_USE_MALLOC=y
CONFIG_PARTITION_TABLE_CUSTOM=y
CONFIG_PARTITION_TABLE_CUSTOM_FILENAME="partitions.csv"
CONFIG_ESP_MAIN_TASK_STACK_SIZE=8192
CONFIG_FREERTOS_HZ=1000
CONFIG_COMPILER_OPTIMIZATION_PERF=y
CONFIG_ESP_VIDEO_ENABLE_MIPI_CSI_VIDEO_DEVICE=y
CONFIG_ESP_VIDEO_ENABLE_ISP_VIDEO_DEVICE=y
CONFIG_CAMERA_SC2336=y
CONFIG_CAMERA_SC2336_MIPI_RAW8_1280X720_30FPS=y
CONFIG_ESP_VIDEO_ENABLE_ISP_PIPELINE_CONTROLLER=y
# CONFIG_ESP_VIDEO_ENABLE_DVP_VIDEO_DEVICE is not set
# CONFIG_ESP_VIDEO_ENABLE_HW_JPEG_VIDEO_DEVICE is not set
# CONFIG_ESP_VIDEO_ENABLE_HW_H264_VIDEO_DEVICE is not set
CONFIG_P4_CAMERA_SD=y
CONFIG_P4_CAMERA_MAX_WIDTH=320
CONFIG_P4_CAMERA_JPEG_QUALITY=45
CONFIG_P4_CAMERA_FPS=5
```
